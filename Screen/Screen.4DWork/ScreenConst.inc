// File generated 1/30/2016 11:54:02 AM
// Warning! This is a generated file, any manual changes will be
// lost during the next generation.

// object indexes into ImageControl
#CONST
    iStatictext1    // offset 0x0
    iStatictext0    // offset 0x5A00
    iWinbutton0     // offset 0xEE00
    iWinbutton2     // offset 0x18A00
    iWinbutton3     // offset 0x22600
    iWinbutton4     // offset 0x2C200
    iAngularmeter0  // offset 0x35E00
    iLeddigits0     // offset 0x31D600
    iiLeddigits0    // offset 0x31FC00
    iStatictext2    // offset 0x325600
    iImage1         // offset 0x326A00
    iImage0         // offset 0x32AA00
    iLeddigits5     // offset 0x340200
    iiLeddigits5    // offset 0x345E00
    iStatictext17   // offset 0x351800
    iLeddigits6     // offset 0x352600
    iiLeddigits6    // offset 0x358200
    iStatictext18   // offset 0x363C00
    iLeddigits9     // offset 0x364C00
    iiLeddigits9    // offset 0x369600
    iStatictext19   // offset 0x374E00
    iLeddigits11    // offset 0x376000
    iiLeddigits11   // offset 0x37BC00
    iLeddigits12    // offset 0x387600
    iiLeddigits12   // offset 0x38D200
    iWinbutton44    // offset 0x398C00
    iWinbutton5     // offset 0x3A4400
    iStatictext3    // offset 0x3AEE00
    iAngularmeter1  // offset 0x3B8E00
    iAngularmeter3  // offset 0x761800
    iGauge0         // offset 0x1608A00
    iStatictext4    // offset 0x198CC00
    iWinbutton8     // offset 0x198D400
    iStatictext37   // offset 0x1997E00
    iStatictext38   // offset 0x199AC00
    iLeddigits19    // offset 0x199AE00
    iiLeddigits19   // offset 0x199DE00
    iStatictext39   // offset 0x19A5400
    iLeddigits4     // offset 0x19A7200
    iiLeddigits4    // offset 0x19AA200
    iStatictext16   // offset 0x19B1800
    iStatictext5    // offset 0x19B2800
    iWinbutton7     // offset 0x19B5000
    iStatictext23   // offset 0x19BCC00
    iStatictext24   // offset 0x19D3800
    iStatictext25   // offset 0x19E6400
    iStatictext26   // offset 0x19E6600
    iStatictext27   // offset 0x19F9200
    iStatictext28   // offset 0x19FA200
    iStatictext29   // offset 0x19FBA00
    iStatictext6    // offset 0x19FE400
    iWinbutton6     // offset 0x1A02A00
    iCoolgauge1     // offset 0x1A0C600
    iWinbutton9     // offset 0x2DFA600
    iWinbutton10    // offset 0x2E02200
    iAngularmeter2  // offset 0x2E09E00
    iLeddigits3     // offset 0x3815600
    iiLeddigits3    // offset 0x3819800
    iStatictext8    // offset 0x3827000
    iLeddigits2     // offset 0x3828000
    iiLeddigits2    // offset 0x382C200
    iStatictext14   // offset 0x3839A00
    iStatictext15   // offset 0x383A800
    iStatictext46   // offset 0x383B800
    iCoolgauge0     // offset 0x3840600
    iStatictext7    // offset 0x4C2E600
    iLeddigits1     // offset 0x4C3B600
    iiLeddigits1    // offset 0x4C51E00
    iStatictext21   // offset 0x4C8A400
    iWinbutton13    // offset 0x4C93600
    iWinbutton14    // offset 0x4C9B600
    iWinbutton16    // offset 0x4CA3600
    iWinbutton18    // offset 0x4CAB600
    iWinbutton19    // offset 0x4CB3600
    iWinbutton20    // offset 0x4CBB600
    iWinbutton22    // offset 0x4CC3600
    iWinbutton23    // offset 0x4CCB600
    iWinbutton24    // offset 0x4CD3600
    iWinbutton52    // offset 0x4CDB600
    iWinbutton77    // offset 0x4CE3600
    iWinbutton90    // offset 0x4CEB600
    iLeddigits15    // offset 0x4CF3600
    iiLeddigits15   // offset 0x4CF9000
    iLeddigits16    // offset 0x4D0BA00
    iiLeddigits16   // offset 0x4D11400
    iStatictext31   // offset 0x4D23E00
    iStatictext32   // offset 0x4D25A00
    iWinbutton29    // offset 0x4D27C00
    iStatictext58   // offset 0x4D31600
    iAngularmeter4  // offset 0x4D3DC00
    iSlider0        // offset 0x5C07800
    iWinbutton25    // offset 0x5E78E00
    iWinbutton26    // offset 0x5E86A00
    iWinbutton27    // offset 0x5E94600
    iWinbutton28    // offset 0x5EA2200
    iWinbutton30    // offset 0x5EAFE00
    iLeddigits31    // offset 0x5EB8400
    iiLeddigits31   // offset 0x5EBD400
    iStatictext57   // offset 0x5ECE000
    iWinbutton1     // offset 0x5ED9400
    iStatictext34   // offset 0x5EE7000
    iWinbutton31    // offset 0x5EEDC00
    iWinbutton35    // offset 0x5EF7800
    iWinbutton36    // offset 0x5EFEE00
    iWinbutton37    // offset 0x5F06400
    iWinbutton38    // offset 0x5F0DA00
    iWinbutton39    // offset 0x5F15000
    iLeddigits14    // offset 0x5F1C600
    iiLeddigits14   // offset 0x5F21C00
    iLeddigits20    // offset 0x5F2CA00
    iiLeddigits20   // offset 0x5F32000
    iLeddigits21    // offset 0x5F3CE00
    iiLeddigits21   // offset 0x5F42C00
    iLeddigits22    // offset 0x5F51800
    iiLeddigits22   // offset 0x5F57600
    iStatictext20   // offset 0x5F66200
    iStatictext22   // offset 0x5F67000
    iStatictext40   // offset 0x5F67C00
    iStatictext41   // offset 0x5F68800
    iLeddigits23    // offset 0x5F69600
    iiLeddigits23   // offset 0x5F6EC00
    iLeddigits24    // offset 0x5F79A00
    iiLeddigits24   // offset 0x5F7F000
    iStatictext42   // offset 0x5F89E00
    iStatictext43   // offset 0x5F8AA00
    iWinbutton40    // offset 0x5F8B800
    iLeddigits25    // offset 0x5F92E00
    iiLeddigits25   // offset 0x5F98C00
    iStatictext44   // offset 0x5FA7800
    iStatictext45   // offset 0x5FA8800
    iStatictext47   // offset 0x5FA9C00
    iStatictext48   // offset 0x5FACA00
    iWinbutton41    // offset 0x5FB0600
    iStatictext50   // offset 0x5FB6C00
    iStatictext49   // offset 0x5FBC000
    iWinbutton42    // offset 0x5FC0200
    iWinbutton53    // offset 0x5FC6C00
    iStatictext54   // offset 0x5FD1600
    iLeddigits27    // offset 0x5FD6A00
    iiLeddigits27   // offset 0x5FDAC00
    iLeddigits28    // offset 0x5FE5200
    iiLeddigits28   // offset 0x5FE9400
    iLeddigits29    // offset 0x5FF3A00
    iiLeddigits29   // offset 0x5FF7C00
    iLeddigits30    // offset 0x6005A00
    iiLeddigits30   // offset 0x6009C00
    iStatictext55   // offset 0x6017A00
    iStatictext56   // offset 0x601CE00
    iWinbutton54    // offset 0x6022200
    iWinbutton55    // offset 0x602CC00
    iWinbutton56    // offset 0x6037600
    iWinbutton57    // offset 0x6042000
    iWinbutton58    // offset 0x604CA00
    iWinbutton59    // offset 0x6057400
    iWinbutton60    // offset 0x6061E00
    iWinbutton61    // offset 0x606C800
    iWinbutton62    // offset 0x6077200
    iWinbutton63    // offset 0x6081C00
    iWinbutton64    // offset 0x608C600
    iWinbutton65    // offset 0x6097000
    iColorpicker0   // offset 0x60A1A00
    iWinbutton43    // offset 0x611DC00
    iStatictext51   // offset 0x6126000
    iWinbutton45    // offset 0x6128E00
    iWinbutton46    // offset 0x6134000
    iWinbutton47    // offset 0x6138200
    iWinbutton48    // offset 0x613C400
    iWinbutton49    // offset 0x6140A00
    iWinbutton50    // offset 0x6145200
    iWinbutton51    // offset 0x6149400
    iStatictext52   // offset 0x614D600
    iWinbutton66    // offset 0x6154C00
    iWinbutton67    // offset 0x615CC00
    iWinbutton68    // offset 0x6164C00
    iWinbutton69    // offset 0x616CC00
    iWinbutton70    // offset 0x6174C00
    iWinbutton71    // offset 0x617CC00
    iWinbutton72    // offset 0x6184C00
    iWinbutton73    // offset 0x618CC00
    iWinbutton74    // offset 0x6194C00
    iWinbutton75    // offset 0x619CC00
    iWinbutton76    // offset 0x61A4C00
    iWinbutton17    // offset 0x61ACC00
    iKnob0          // offset 0x61B9C00
    iWinbutton21    // offset 0x6438600
    iLeddigits26    // offset 0x6445600
    iiLeddigits26   // offset 0x6451200
    i4Dbutton0      // offset 0x6478A00
    iStatictext53   // offset 0x6480C00
    iStatictext59   // offset 0x6483000
    iStatictext60   // offset 0x6484C00
    i4Dbutton1      // offset 0x6486C00
    iStatictext61   // offset 0x648EE00
    iStatictext62   // offset 0x6490800
    iWinbutton78    // offset 0x6492200
    iWinbutton79    // offset 0x6498000
    iWinbutton80    // offset 0x649DE00
    iWinbutton81    // offset 0x64A3C00
    iWinbutton82    // offset 0x64A9A00
    iLeddigits32    // offset 0x64B6E00
    iiLeddigits32   // offset 0x64BAA00
    iLeddigits33    // offset 0x64C7000
    iiLeddigits33   // offset 0x64CAC00
    iStatictext63   // offset 0x64D7200
    iStatictext64   // offset 0x64D8C00
    iUserled2       // offset 0x64DA800
    iUserled3       // offset 0x64DB600
    iUserled4       // offset 0x64DC400
    iUserled5       // offset 0x64DD200
    iStatictext65   // offset 0x64DE000
    iStatictext66   // offset 0x64DE400
    iStatictext67   // offset 0x64DE800
    iStatictext68   // offset 0x64DEC00
    iStatictext69   // offset 0x64DF000
    iColorpicker1   // offset 0x64E8800
    iWinbutton83    // offset 0x6564A00
    iWinbutton84    // offset 0x6568C00
    iWinbutton85    // offset 0x656CE00
    iWinbutton86    // offset 0x6571000
    iWinbutton87    // offset 0x6575200
    iWinbutton88    // offset 0x6579400
    iWinbutton89    // offset 0x657D600
    iWinbutton91    // offset 0x658B000
    i4Dbutton2      // offset 0x6594E00
    iWinbutton92    // offset 0x659D000
    iWinbutton93    // offset 0x65A6E00
    iWinbutton94    // offset 0x65B0C00
    iWinbutton95    // offset 0x65BAA00
    iWinbutton96    // offset 0x65C4800
    iWinbutton33    // offset 0x65CE600
    iStatictext35   // offset 0x65D6A00
    iStatictext36   // offset 0x65D8000
    iStatictext70   // offset 0x65DB800
    iAngularmeter5  // offset 0x65E9400
    iAngularmeter6  // offset 0x7FCAA00
#END

#IFNOT EXISTS NOGLOBALS
var hndl ;
#ENDIF
